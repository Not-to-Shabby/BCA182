## prj.conf
```kconfig
# Zephyr Kernel & Logging
CONFIG_PRINTK=y
CONFIG_LOG=y
CONFIG_LOG_MODE_MINIMAL=y
CONFIG_MAIN_STACK_SIZE=4096
CONFIG_SYSTEM_WORKQUEUE_STACK_SIZE=2048
CONFIG_HEAP_MEM_POOL_SIZE=65536

# Ring Buffer & Serial
CONFIG_RING_BUFFER=y
CONFIG_SERIAL=y
CONFIG_UART_INTERRUPT_DRIVEN=y

# Wi-Fi Subsystem
CONFIG_WIFI=y
CONFIG_WIFI_ESP32=y

# Networking Core & IPv4
CONFIG_NETWORKING=y
CONFIG_NET_L2_ETHERNET=y
CONFIG_NET_IPV4=y
CONFIG_NET_DHCPV4=y
CONFIG_NET_TCP=y
CONFIG_NET_UDP=y
CONFIG_NET_SOCKETS=y
CONFIG_NET_SOCKETS_POSIX_NAMES=y
CONFIG_NET_CONNECTION_MANAGER=y

# Network Buffers for Audio Streaming
CONFIG_NET_PKT_RX_COUNT=16
CONFIG_NET_PKT_TX_COUNT=16
CONFIG_NET_BUF_RX_COUNT=32
CONFIG_NET_BUF_TX_COUNT=32
CONFIG_NET_MAX_CONTEXTS=8
```

## app.overlay
```dts
/*
 * DeviceTree Overlay for ESP32-S3 Wi-Fi Audio Streaming Co-Processor
 * Maps High-Speed UART1 to GPIO 17 (TX) and GPIO 18 (RX) for RT-Spark link.
 */

/ {
	chosen {
		spark_comm_uart = &uart1;
	};
};

&uart1 {
	status = "okay";
	current-speed = <2000000>;
	pinctrl-0 = <&uart1_default>;
	pinctrl-names = "default";
};
```

## src/main.c
```c
/**
 * @file main.c
 * @brief ESP32-S3 Wi-Fi Audio Streaming Co-Processor Main Entry Point (Zephyr RTOS).
 */

#include "wifi_protocol.h"
#include "wifi_manager.h"
#include "audio_receiver.h"
#include <zephyr/kernel.h>
#include <string.h>
#include <stdio.h>

/* Forward declarations */
int protocol_bridge_init(void (*cb)(uint8_t cmd_type, const uint8_t *payload, uint16_t len));
void protocol_bridge_send_frame(uint8_t type, const uint8_t *payload, uint16_t len);
void protocol_bridge_send_pcm(const uint8_t *pcm_bytes, uint16_t len);
void protocol_bridge_send_meta(const wifi_track_meta_t *meta);
void protocol_bridge_send_telemetry(const wifi_telemetry_t *telem);
void protocol_bridge_send_ping(void);
bool protocol_bridge_is_spark_detected(void);
void protocol_bridge_process_rx(void);
int upnp_renderer_init(void);

static void on_pcm_chunk(const uint8_t *pcm, uint16_t len)
{
    /* Forward uncompressed 16-bit 44.1kHz stereo PCM block over 2.0 Mbps UART link to RT-Spark */
    protocol_bridge_send_pcm(pcm, len);
}

static void on_meta_update(const wifi_track_meta_t *meta)
{
    /* Forward track metadata (Title, Artist, Album) to RT-Spark LCD */
    protocol_bridge_send_meta(meta);
}

static void on_telemetry_update(const wifi_telemetry_t *telem)
{
    /* Forward Wi-Fi telemetry to RT-Spark */
    protocol_bridge_send_telemetry(telem);
}

static void on_spark_command(uint8_t cmd_type, const uint8_t *payload, uint16_t len)
{
    if (cmd_type == WIFI_CMD_BUTTON && len >= 1) {
        audio_receiver_handle_command(payload[0]);
    } else if (cmd_type == WIFI_CMD_SET_WIFI && len >= 1) {
        uint8_t sub = payload[0];
        if (sub == 1) {
            wifi_manager_start_ap("RT-Spark-Audio", "12345678");
        } else if (sub == 2 && len >= 34) {
            char ssid[33] = {0};
            char pass[65] = {0};
            memcpy(ssid, payload + 1, 32);
            memcpy(pass, payload + 33, len - 33);
            wifi_manager_connect_sta(ssid, pass);
        } else if (sub == 3) {
            wifi_manager_scan();
        }
    }
}

int main(void)
{
    printk("\n=======================================================\n");
    printk(" ESP32-S3 Wi-Fi Audio Streaming Co-Processor\n");
    printk(" Zephyr RTOS v3.x | Target: RT-Spark STM32F407 Link\n");
    printk("=======================================================\n");

    protocol_bridge_init(on_spark_command);
    wifi_manager_init(on_telemetry_update);
    audio_receiver_init(on_pcm_chunk, on_meta_update);

    /* 1. Boot Handshake: Ping RT-Spark over UART for up to 2 seconds */
    printk("[Boot] Sending Handshake Ping to RT-Spark...\n");
    bool spark_found = false;
    for (int i = 0; i < 20; i++) {
        protocol_bridge_send_ping();
        k_msleep(100);
        protocol_bridge_process_rx();
        if (protocol_bridge_is_spark_detected()) {
            spark_found = true;
            break;
        }
    }

    if (spark_found) {
        printk("[Boot] RT-Spark Detected! Entering Spark-Controlled Mode.\n");
    } else {
        printk("[Boot] Standalone Mode: Starting Auto Hotspot ('RT-Spark-Audio')...\n");
        wifi_manager_start_ap("RT-Spark-Audio", "12345678");
    }

    upnp_renderer_init();

    /* 2. Main Run Loop */
    uint32_t telem_timer = 0;
    while (1) {
        protocol_bridge_process_rx();

        k_msleep(20);
        telem_timer += 20;
        if (telem_timer >= 1000) {
            telem_timer = 0;
            wifi_telemetry_t telem;
            wifi_manager_get_telemetry(&telem);
            protocol_bridge_send_telemetry(&telem);
        }
    }

    return 0;
}
```

## src/main.cpp
```c
/**
 * @file main.cpp
 * @brief ESP32-S3 Super Mini Wi-Fi Audio Streaming & DLNA Co-Processor with Captive Portal.
 *
 * Board: ESP32-S3 Super Mini (ESP32-S3FH4R2, 4MB Flash, 2MB PSRAM)
 * Features:
 *   - Auto Hotspot with Captive Portal (DNS redirect & Web config interface)
 *   - Persistent NVS storage for Home Wi-Fi credentials (survives power off)
 *   - UPnP / DLNA MediaRenderer SSDP discovery
 *   - UDP Low-Latency 44.1 kHz 16-bit stereo PCM audio receiver on port 44100
 *   - High-Speed UART1 output to RT-Spark (GPIO 43 TX / GPIO 44 RX @ 2.0 Mbps)
 *
 * Connections:
 *   - Pin labeled "TX" (GPIO 43) -> RT-Spark Pin 10 (PA3: USART2_RX)
 *   - Pin labeled "RX" (GPIO 44) -> RT-Spark Pin 8  (PA2: USART2_TX)
 *   - Pin labeled "GND"          -> RT-Spark GND
 *   - Pin labeled "5V"           -> RT-Spark Pin 2 (+5V_SYS)
 */

#include <Arduino.h>
#include <WiFi.h>
#include <WiFiUdp.h>
#include <DNSServer.h>
#include <WebServer.h>
#include <Preferences.h>
#include "wifi_protocol.h"
#include "upnp_renderer.h"
#include "airplay_bridge.h"
#include "ariacast_server.h"

#define PIN_UART_TX             43  /* Header pin labeled "TX" */
#define PIN_UART_RX             44  /* Header pin labeled "RX" */
#define PIN_RGB_LED             48  /* Onboard WS2812 RGB LED */
#define UART_BAUD_RATE          2000000

#define UDP_AUDIO_PORT          44100
#define SSDP_PORT               1900
#define DNS_PORT                53

static void set_led_color(uint8_t r, uint8_t g, uint8_t b)
{
    neopixelWrite(PIN_RGB_LED, r, g, b);
}

static WiFiUDP s_udp_audio;
static DNSServer s_dns_server;
static WebServer s_web_server(80);
static Preferences s_prefs;

static wifi_track_meta_t s_meta = {};
static wifi_telemetry_t s_telem = {};

static bool s_spark_detected = false;
static uint32_t s_last_pong_ms = 0;
static bool s_portal_active = false;
static bool s_sta_connect_requested = false;
static String s_target_ssid = "";
static String s_target_pass = "";

static SemaphoreHandle_t s_uart_mutex = nullptr;

/* Send structured packet to RT-Spark over High-Speed Serial1 (callable from any task) */
void send_spark_packet(uint8_t type, const uint8_t *payload, uint16_t len)
{
    uint8_t hdr[5];
    hdr[0] = WIFI_PROTO_SYNC1;
    hdr[1] = WIFI_PROTO_SYNC2;
    hdr[2] = type;
    hdr[3] = (uint8_t)(len & 0xFFU);
    hdr[4] = (uint8_t)((len >> 8) & 0xFFU);
    uint8_t cks = wifi_protocol_checksum(type, len, payload);

    if (s_uart_mutex != nullptr) {
        xSemaphoreTake(s_uart_mutex, portMAX_DELAY);
    }
    Serial1.write(hdr, 5);
    if (payload != nullptr && len > 0) {
        Serial1.write(payload, len);
    }
    Serial1.write(cks);
    if (s_uart_mutex != nullptr) {
        xSemaphoreGive(s_uart_mutex);
    }
}

void spark_set_stream_state(uint8_t state)
{
    s_telem.stream_state = state;
}

void spark_set_volume(uint8_t percent)
{
    s_telem.volume_percent = percent;
}

/* Forward declarations */
static void start_access_point(void);
static void connect_station(const char *ssid, const char *pass);
static void handle_portal_root(void);
static void handle_portal_save(void);
static void handle_portal_scan(void);

static void setup_captive_portal(void)
{
    /* Start DNS redirect server: maps every domain to 192.168.4.1 */
    s_dns_server.setErrorReplyCode(DNSReplyCode::NoError);
    s_dns_server.start(DNS_PORT, "*", WiFi.softAPIP());

    /* Web Server routing */
    s_web_server.on("/", HTTP_GET, handle_portal_root);
    s_web_server.on("/save", HTTP_POST, handle_portal_save);
    s_web_server.on("/scan", HTTP_GET, handle_portal_scan);

    /* Captive portal detection hooks for Android, iOS, Windows */
    s_web_server.on("/generate_204", HTTP_GET, handle_portal_root);
    s_web_server.on("/gen_204", HTTP_GET, handle_portal_root);
    s_web_server.on("/hotspot-detect.html", HTTP_GET, handle_portal_root);
    s_web_server.on("/canonical.html", HTTP_GET, handle_portal_root);
    s_web_server.on("/ncsi.txt", HTTP_GET, handle_portal_root);
    s_web_server.onNotFound([]() {
        s_web_server.sendHeader("Location", "http://192.168.4.1/", true);
        s_web_server.send(302, "text/plain", "Redirecting to Captive Portal...");
    });

    s_web_server.begin();
    s_portal_active = true;
    Serial.println("[Portal] Captive Portal & DNS redirect server running on port 80/53!");
}

static void start_access_point(void)
{
    Serial.println("[WiFi] Starting Access Point 'RT-Spark-Audio'...");
    set_led_color(40, 20, 0); /* Orange/Yellow: Captive Portal AP mode */
    WiFi.mode(WIFI_AP);
    WiFi.softAP(CONFIG_WIFI_DEFAULT_AP_SSID, CONFIG_WIFI_DEFAULT_AP_PASS);
    IPAddress ip = WiFi.softAPIP();

    s_telem.wifi_mode = WIFI_STATE_AP;
    snprintf(s_telem.ip_addr, sizeof(s_telem.ip_addr), "%s", ip.toString().c_str());
    s_telem.rssi_dbm = 0;

    WiFi.setTxPower(WIFI_POWER_19_5dBm);
    Serial.printf("[WiFi] AP Started! IP Address: %s (TX Power: 19.5 dBm)\n", s_telem.ip_addr);
    setup_captive_portal();
}

static void connect_station(const char *ssid, const char *pass)
{
    Serial.printf("[WiFi] Connecting to Station '%s'...\n", ssid);
    set_led_color(30, 30, 0); /* Yellow: Connecting... */
    s_portal_active = false;
    s_dns_server.stop();
    s_web_server.stop();

    WiFi.mode(WIFI_STA);
    WiFi.begin(ssid, pass);

    uint32_t t0 = millis();
    while (WiFi.status() != WL_CONNECTED && (millis() - t0 < 8000)) {
        delay(200);
        Serial.print(".");
    }
    Serial.println();

    if (WiFi.status() == WL_CONNECTED) {
        IPAddress ip = WiFi.localIP();
        s_telem.wifi_mode = WIFI_STATE_STA;
        snprintf(s_telem.ip_addr, sizeof(s_telem.ip_addr), "%s", ip.toString().c_str());
        s_telem.rssi_dbm = (int8_t)WiFi.RSSI();
        Serial.printf("[WiFi] Connected! IP Address: %s (RSSI %d dBm)\n", s_telem.ip_addr, s_telem.rssi_dbm);
        set_led_color(0, 40, 0); /* Solid Green: Connected to Home Wi-Fi! */

        /* Maximize RF output to 19.5 dBm for the small ceramic antenna while keeping modem sleep */
        WiFi.setTxPower(WIFI_POWER_19_5dBm);
        WiFi.setSleep(WIFI_PS_MIN_MODEM);

        /* Save successful credentials to NVS */
        s_prefs.putString("ssid", ssid);
        s_prefs.putString("pass", pass);
    } else {
        Serial.println("[WiFi] Connection failed! Falling back to Captive Portal...");
        set_led_color(40, 0, 0); /* Red: Failed, starting AP */
        delay(500);
        start_access_point();
    }
}

/* Captive Portal HTML UI */
static void handle_portal_root(void)
{
    String html = "<!DOCTYPE html><html><head><meta name='viewport' content='width=device-width,initial-scale=1'>";
    html += "<title>RT-Spark Wi-Fi Audio Setup</title><style>";
    html += "body{font-family:sans-serif;background:#0d1117;color:#c9d1d9;margin:0;padding:20px;text-align:center;}";
    html += ".card{background:#161b22;border:1px solid #30363d;border-radius:12px;padding:24px;max-width:380px;margin:auto;box-shadow:0 8px 24px rgba(0,0,0,0.5);}";
    html += "h1{color:#ffd33d;font-size:20px;margin-bottom:6px;}";
    html += "p{color:#8b949e;font-size:14px;margin-top:0;}";
    html += ".status{background:#1f242c;padding:8px;border-radius:6px;font-size:13px;color:#58a6ff;margin-bottom:18px;}";
    html += "input,select{width:100%;box-sizing:border-box;padding:12px;margin:8px 0;background:#0d1117;border:1px solid #30363d;border-radius:6px;color:#fff;font-size:15px;}";
    html += "button{width:100%;padding:13px;margin-top:14px;background:#238636;border:none;border-radius:6px;color:#fff;font-weight:bold;font-size:16px;cursor:pointer;}";
    html += "button:hover{background:#2ea043;}";
    html += ".net-list{text-align:left;max-height:160px;overflow-y:auto;border:1px solid #30363d;border-radius:6px;padding:4px;margin-bottom:12px;background:#0d1117;}";
    html += ".net-item{padding:8px 10px;cursor:pointer;border-bottom:1px solid #21262d;font-size:14px;display:flex;justify-content:space-between;}";
    html += ".net-item:hover{background:#1f242c;color:#ffd33d;}";
    html += "</style></head><body><div class='card'>";
    html += "<h1>RT-Spark Wi-Fi Audio</h1>";
    html += "<p>ESP32-S3 Super Mini Co-Processor</p>";
    html += "<div class='status'>IP: " + String(s_telem.ip_addr) + "</div>";
    
    html += "<div class='net-list'>";
    int n = WiFi.scanNetworks();
    if (n == 0) {
        html += "<div style='padding:10px;color:#8b949e;'>No Wi-Fi networks found</div>";
    } else {
        for (int i = 0; i < n; ++i) {
            String s = WiFi.SSID(i);
            int r = WiFi.RSSI(i);
            html += "<div class='net-item' onclick='selectSSID(\"" + s + "\")'>";
            html += "<span>" + s + "</span><span style='color:#8b949e;'>" + String(r) + " dBm</span></div>";
        }
    }
    html += "</div>";

    html += "<form action='/save' method='POST'>";
    html += "<input type='text' id='ssid' name='ssid' placeholder='Wi-Fi Network Name' required>";
    html += "<input type='password' id='pass' name='password' placeholder='Wi-Fi Password'>";
    html += "<button type='submit'>Connect & Save</button>";
    html += "</form>";

    html += "<script>";
    html += "function selectSSID(s){document.getElementById('ssid').value=s;document.getElementById('pass').focus();}";
    html += "</script>";

    html += "</div></body></html>";
    s_web_server.send(200, "text/html", html);
}

static void handle_portal_scan(void)
{
    WiFi.scanNetworks(true);
    s_web_server.sendHeader("Location", "/", true);
    s_web_server.send(302, "text/plain", "Scanning...");
}

static void handle_portal_save(void)
{
    String ssid = s_web_server.arg("ssid");
    String pass = s_web_server.arg("password");

    String html = "<!DOCTYPE html><html><head><meta name='viewport' content='width=device-width,initial-scale=1'>";
    html += "<style>body{font-family:sans-serif;background:#0d1117;color:#c9d1d9;padding:40px;text-align:center;}</style></head>";
    html += "<body><h2>Connecting to " + ssid + "...</h2>";
    html += "<p>Credentials saved. The ESP32 is now connecting to your home Wi-Fi network.</p>";
    html += "<p>You can now reconnect your phone to <b>" + ssid + "</b> and stream music!</p></body></html>";

    s_web_server.send(200, "text/html", html);
    delay(500);

    s_target_ssid = ssid;
    s_target_pass = pass;
    s_sta_connect_requested = true;
}

/* Core 0 FreeRTOS Thread for UDP Audio Packet Receiving */
static void audio_network_task(void *param)
{
    (void)param;
    s_udp_audio.begin(UDP_AUDIO_PORT);
    Serial.printf("[Audio] UDP streaming listener active on port %d\n", UDP_AUDIO_PORT);

    static uint8_t packet_buffer[1024];

    while (true) {
        int pkt_size = s_udp_audio.parsePacket();
        if (pkt_size > 0) {
            int len = s_udp_audio.read(packet_buffer, sizeof(packet_buffer));
            if (len > 0) {
                if (len >= 4 && memcmp(packet_buffer, "META", 4) == 0 && len >= (4 + (int)sizeof(wifi_track_meta_t))) {
                    memcpy(&s_meta, packet_buffer + 4, sizeof(s_meta));
                    send_spark_packet(WIFI_MSG_TRACK_META, (const uint8_t *)&s_meta, sizeof(s_meta));
                    Serial.printf("[Audio] Track Meta: '%s' by '%s'\n", s_meta.title, s_meta.artist);
                } else {
                    /* Forward 16-bit 44.1kHz stereo PCM to RT-Spark in frames of at most 512 bytes */
                    len &= ~3;
                    for (int off = 0; off < len; off += AUDIO_CHUNK_BYTES) {
                        int n = len - off;
                        if (n > (int)AUDIO_CHUNK_BYTES) {
                            n = (int)AUDIO_CHUNK_BYTES;
                        }
                        send_spark_packet(WIFI_MSG_AUDIO_PCM, packet_buffer + off, (uint16_t)n);
                    }
                    s_telem.stream_state = STREAM_STATE_PLAYING;
                }
            }
        } else {
            vTaskDelay(pdMS_TO_TICKS(5));
        }
    }
}

/* Parse incoming commands from RT-Spark */
static void process_spark_input(void)
{
    static uint8_t state = 0;
    static uint8_t msg_type = 0;
    static uint16_t msg_len = 0;
    static uint8_t payload[128];
    static uint16_t rx_idx = 0;

    while (Serial1.available()) {
        uint8_t b = (uint8_t)Serial1.read();
        switch (state) {
        case 0:
            if (b == WIFI_PROTO_SYNC1) state = 1;
            break;
        case 1:
            if (b == WIFI_PROTO_SYNC2) state = 2;
            else state = 0;
            break;
        case 2:
            msg_type = b;
            state = 3;
            break;
        case 3:
            msg_len = b;
            state = 4;
            break;
        case 4:
            msg_len |= ((uint16_t)b << 8);
            if (msg_len > sizeof(payload)) {
                state = 0;
            } else if (msg_len == 0) {
                state = 6;
            } else {
                rx_idx = 0;
                state = 5;
            }
            break;
        case 5:
            payload[rx_idx++] = b;
            if (rx_idx >= msg_len) {
                state = 6;
            }
            break;
        case 6: {
            uint8_t cks = wifi_protocol_checksum(msg_type, msg_len, payload);
            if (cks == b) {
                if (msg_type == WIFI_MSG_PONG) {
                    s_spark_detected = true;
                    s_last_pong_ms = millis();
                } else if (msg_type == WIFI_CMD_BUTTON && msg_len >= 1) {
                    uint8_t cmd = payload[0];
                    Serial.printf("[Control] Button Command from RT-Spark: 0x%02X\n", cmd);
                    upnp_button(cmd);
                    if (cmd == BTN_CMD_PLAY_PAUSE) {
                        ariacast_server_button_action("play");
                    } else if (cmd == BTN_CMD_NEXT) {
                        ariacast_server_button_action("next");
                    } else if (cmd == BTN_CMD_PREV) {
                        ariacast_server_button_action("previous");
                    }
                } else if (msg_type == WIFI_CMD_SET_WIFI && msg_len >= 1) {
                    if (payload[0] == 1) {
                        start_access_point();
                    }
                }
            }
            state = 0;
            break;
        }
        default:
            state = 0;
            break;
        }
    }

    if (s_spark_detected && (millis() - s_last_pong_ms > 4000)) {
        s_spark_detected = false;
    }
}

void setup()
{
    /* Initialize default metadata and telemetry */
    strncpy(s_meta.title, "Ready to Stream", sizeof(s_meta.title) - 1);
    strncpy(s_meta.artist, "Connect to Wi-Fi", sizeof(s_meta.artist) - 1);
    strncpy(s_meta.album, "RT-Spark Wireless", sizeof(s_meta.album) - 1);
    strncpy(s_meta.format, "WAV 16-bit 44.1k", sizeof(s_meta.format) - 1);

    s_telem.wifi_mode = WIFI_STATE_IDLE;
    strncpy(s_telem.ip_addr, "0.0.0.0", sizeof(s_telem.ip_addr) - 1);
    s_telem.rssi_dbm = 0;
    s_telem.stream_state = STREAM_STATE_STOPPED;
    s_telem.volume_percent = 80;

    s_uart_mutex = xSemaphoreCreateMutex();

    /* Native USB CDC Serial for PC Monitor & Debugging */
    Serial.begin(115200);

    /* Hardware High-Speed UART1 to RT-Spark (GPIO 43 TX / GPIO 44 RX @ 2.0 Mbps) */
    Serial1.setTxBufferSize(2048);
    Serial1.begin(UART_BAUD_RATE, SERIAL_8N1, PIN_UART_RX, PIN_UART_TX);

    delay(500);
    Serial.println("\n=======================================================");
    Serial.println(" ESP32-S3 Super Mini Wi-Fi Audio Streaming Co-Processor");
    Serial.println(" Output: High-Speed UART1 @ 2.0 Mbps (GPIO43 TX/GPIO44 RX)");
    Serial.println(" Captive Portal: Auto-detect & DNS redirect on 192.168.4.1");
    Serial.println("=======================================================");

    /* Initialize persistent NVS memory for Home Wi-Fi credentials */
    s_prefs.begin("wifi_cfg", false);
    String saved_ssid = s_prefs.getString("ssid", "");
    String saved_pass = s_prefs.getString("pass", "");

    /* Boot Handshake: Ping RT-Spark for up to 2 seconds */
    Serial.println("[Boot] Sending Handshake Ping to RT-Spark...");
    uint32_t start_ms = millis();
    while (millis() - start_ms < 2000) {
        send_spark_packet(WIFI_MSG_PING, nullptr, 0);
        delay(100);
        process_spark_input();
        if (s_spark_detected) {
            break;
        }
    }

    if (s_spark_detected) {
        Serial.println("[Boot] RT-Spark Board Detected! Synchronized.");
    }

    /* Check if we have saved home Wi-Fi credentials */
    if (saved_ssid.length() > 0) {
        Serial.printf("[Boot] Found saved home Wi-Fi credentials for '%s'. Connecting...\n", saved_ssid.c_str());
        connect_station(saved_ssid.c_str(), saved_pass.c_str());
    } else {
        Serial.println("[Boot] No saved credentials. Starting Captive Portal Hotspot...");
        start_access_point();
    }

    /* Start UPnP/DLNA MediaRenderer (SSDP + SOAP control on port 8080) */
    upnp_begin();

    /* Start Apple AirPlay / RAOP Receiver (mDNS + RTSP control on port 5000) */
    airplay_begin();

    /* Start AriaCast Native Receiver (UDP discovery on 12888 + WebSocket on 12889) */
    ariacast_server_begin();

    /* Spawn High-Priority Dedicated Network Audio Task on Core 0 */
    xTaskCreatePinnedToCore(audio_network_task, "audio_net", 4096, nullptr, 5, nullptr, 0);
}

void loop()
{
    process_spark_input();

    /* Handle Captive Portal DNS and HTTP requests if AP mode is active */
    if (s_portal_active) {
        s_dns_server.processNextRequest();
        s_web_server.handleClient();
    }

    /* Process pending connection request from web portal */
    if (s_sta_connect_requested) {
        s_sta_connect_requested = false;
        connect_station(s_target_ssid.c_str(), s_target_pass.c_str());
        upnp_begin();
        airplay_begin();
        ariacast_server_begin();
    }

    upnp_loop();

    /* Send telemetry periodically */
    static uint32_t last_telem_ms = 0;
    if (millis() - last_telem_ms >= 1000) {
        last_telem_ms = millis();

        if (s_telem.wifi_mode == WIFI_STATE_STA && WiFi.status() == WL_CONNECTED) {
            s_telem.rssi_dbm = (int8_t)WiFi.RSSI();
        }

        /* Forward telemetry to RT-Spark ST7789 screen */
        send_spark_packet(WIFI_MSG_TELEMETRY, (const uint8_t *)&s_telem, sizeof(s_telem));

        /* Thermal & health monitoring every 5 seconds */
        static uint32_t last_temp_ms = 0;
        if (millis() - last_temp_ms >= 5000) {
            last_temp_ms = millis();
            float chip_temp = temperatureRead();
            size_t psram_free = heap_caps_get_free_size(MALLOC_CAP_SPIRAM);
            Serial.printf("[System] Chip Temp: %.1f °C, Free Heap: %u bytes, PSRAM: %u bytes\n",
                          chip_temp, (unsigned)esp_get_free_heap_size(), (unsigned)psram_free);
        }
    }

    delay(5);
}
```

## include/audio_receiver.h
```c
/**
 * @file audio_receiver.h
 * @brief High-throughput network audio socket receiver & ring buffer for ESP32-S3.
 */

#ifndef AUDIO_RECEIVER_H_
#define AUDIO_RECEIVER_H_

#include <stdint.h>
#include <stdbool.h>
#include "wifi_protocol.h"

#ifdef __cplusplus
extern "C" {
#endif

typedef void (*audio_chunk_cb_t)(const uint8_t *pcm_bytes, uint16_t len);
typedef void (*meta_update_cb_t)(const wifi_track_meta_t *meta);

/**
 * @brief Initialize audio network streaming servers (UDP 44100 & TCP 8080).
 */
int audio_receiver_init(audio_chunk_cb_t pcm_cb, meta_update_cb_t meta_cb);

/**
 * @brief Push control command received from RT-Spark to active stream (Pause/Resume/Next/Prev).
 */
void audio_receiver_handle_command(uint8_t cmd);

/**
 * @brief Get current playback track metadata.
 */
void audio_receiver_get_meta(wifi_track_meta_t *out);

#ifdef __cplusplus
}
#endif

#endif /* AUDIO_RECEIVER_H_ */
```

## include/upnp_renderer.h
```c
/**
 * @file upnp_renderer.h
 * @brief UPnP/DLNA MediaRenderer (SSDP discovery, AVTransport/RenderingControl SOAP, HTTP WAV pull).
 */

#ifndef UPNP_RENDERER_H_
#define UPNP_RENDERER_H_

#include <stdint.h>
#include <stddef.h>

#ifdef __cplusplus
extern "C" {
#endif

/* Implemented by main.cpp */
void send_spark_packet(uint8_t type, const uint8_t *payload, uint16_t len);
void spark_set_stream_state(uint8_t state);
void spark_set_volume(uint8_t percent);

/* Implemented by upnp_renderer.cpp */
void upnp_begin(void);
void upnp_loop(void);
void upnp_button(uint8_t cmd);

/* AriaCast Bridge */
void ariacast_start_stream(void);
void ariacast_stop_stream(void);
void ariacast_set_metadata(const char *title, const char *artist, const char *album);
void ariacast_set_volume(uint8_t volume);
void ariacast_feed_pcm(const int16_t *pcm, size_t samples, int ch, int rate);

#ifdef __cplusplus
}
#endif

#endif /* UPNP_RENDERER_H_ */
```

## include/wifi_manager.h
```c
/**
 * @file wifi_manager.h
 * @brief Wi-Fi Connection & Access Point Manager for ESP32-S3 under Zephyr RTOS.
 */

#ifndef WIFI_MANAGER_H_
#define WIFI_MANAGER_H_

#include <stdint.h>
#include <stdbool.h>
#include "wifi_protocol.h"

#ifdef __cplusplus
extern "C" {
#endif

typedef void (*wifi_state_change_cb_t)(const wifi_telemetry_t *telemetry);

/**
 * @brief Initialize Wi-Fi subsystem.
 */
int wifi_manager_init(wifi_state_change_cb_t cb);

/**
 * @brief Start standalone private Hotspot (Access Point mode).
 * @param ssid Hotspot SSID (e.g. "RT-Spark-Audio")
 * @param psk Password (at least 8 chars)
 */
int wifi_manager_start_ap(const char *ssid, const char *psk);

/**
 * @brief Connect to existing home Wi-Fi network (Station mode).
 */
int wifi_manager_connect_sta(const char *ssid, const char *psk);

/**
 * @brief Trigger an asynchronous Wi-Fi scan of nearby networks.
 */
int wifi_manager_scan(void);

/**
 * @brief Get current telemetry snapshot.
 */
void wifi_manager_get_telemetry(wifi_telemetry_t *out);

#ifdef __cplusplus
}
#endif

#endif /* WIFI_MANAGER_H_ */
```

## src/airplay_bridge.cpp
```c
#include "airplay_bridge.h"
#include <Arduino.h>
#include <WiFi.h>
#include "esp_mac.h"
#include "esp_log.h"
#include "airplay/raop.h"
#include "airplay/mdns_service.h"

static bool s_airplay_running = false;

static void on_raop_state_event(raop_event_t ev)
{
    if (ev == RAOP_EV_STREAMING) {
        Serial.println("[AirPlay] Streaming session active");
    } else {
        Serial.println("[AirPlay] Streaming session ended");
    }
}

void airplay_begin(void)
{
    if (s_airplay_running) {
        return;
    }

    uint8_t mac[6];
    esp_read_mac(mac, ESP_MAC_WIFI_STA);

    char instance_name[64];
    snprintf(instance_name, sizeof(instance_name), "%02X%02X%02X%02X%02X%02X@RT-Spark Hi-Fi",
             mac[0], mac[1], mac[2], mac[3], mac[4], mac[5]);

    Serial.printf("[AirPlay] Advertising RAOP '%s' on port %d\n", instance_name, RAOP_RTSP_PORT);

    // Advertise via mDNS
    mdns_advertise_raop("rtspark", instance_name, RAOP_RTSP_PORT);

    // Register session event callback
    raop_set_event_cb(on_raop_state_event);

    // Start RTSP control server (port 5000)
    raop_server_start();
    s_airplay_running = true;
    Serial.println("[AirPlay] RAOP server active on port 5000! Discovered as 'RT-Spark Hi-Fi'.");
}

void airplay_stop(void)
{
    if (!s_airplay_running) {
        return;
    }
    raop_server_stop();
    s_airplay_running = false;
}
```

## src/airplay_bridge.h
```c
#ifndef AIRPLAY_BRIDGE_H_
#define AIRPLAY_BRIDGE_H_

#ifdef __cplusplus
extern "C" {
#endif

void airplay_begin(void);
void airplay_stop(void);

#ifdef __cplusplus
}
#endif

#endif /* AIRPLAY_BRIDGE_H_ */
```

## src/ariacast_server.cpp
```c
/**
 * @file ariacast_server.cpp
 * @brief Native AriaCast audio receiver & discovery server for ESP32-S3.
 *
 * Implements:
 *   - UDP Discovery on port 12888 ("DISCOVER_AUDIOCAST" query -> JSON response)
 *   - RFC6455 WebSocket streaming on port 12889:
 *       /audio    : Binary WebSocket frames (3840 bytes raw 16-bit 48kHz stereo PCM)
 *       /metadata : Track title, artist, album sync (WebSocket or HTTP POST)
 *       /control  : Remote volume control and playback actions (Play/Pause/Skip)
 */

#include "ariacast_server.h"
#include <Arduino.h>
#include <WiFi.h>
#include <ArduinoJson.h>
#include <lwip/sockets.h>
#include <lwip/inet.h>
#include <mbedtls/sha1.h>
#include <mbedtls/base64.h>
#include "upnp_renderer.h"

#define MAX_WS_CLIENTS        4
#define WS_AUDIO_FRAME_BYTES  3840U

enum ClientRole {
    ROLE_NONE,
    ROLE_AUDIO,
    ROLE_CONTROL,
    ROLE_METADATA,
    ROLE_STATS
};

struct AriaClient {
    int fd;
    ClientRole role;
    bool is_websocket;
    uint32_t last_activity;
};

static TaskHandle_t s_aria_task = nullptr;
static volatile bool s_aria_running = false;
static int s_udp_fd = -1;
static int s_listen_fd = -1;
static AriaClient s_clients[MAX_WS_CLIENTS];
static int s_control_fd = -1;

/* ---------------------------------------------------------------- WebSocket Helpers */

static void compute_ws_accept(const char *key, char *out, size_t max_out)
{
    char combined[128];
    snprintf(combined, sizeof(combined), "%s258EAFA5-E914-47DA-95CA-C5AB0DC85B11", key);

    uint8_t hash[20];
    mbedtls_sha1((const unsigned char *)combined, strlen(combined), hash);

    size_t olen = 0;
    mbedtls_base64_encode((unsigned char *)out, max_out, &olen, hash, 20);
    out[olen] = '\0';
}

static void ws_send_text(int fd, const char *text)
{
    size_t len = strlen(text);
    uint8_t hdr[10];
    size_t hlen = 0;
    hdr[0] = 0x81; // FIN + text opcode

    if (len < 126) {
        hdr[1] = (uint8_t)len;
        hlen = 2;
    } else {
        hdr[1] = 126;
        hdr[2] = (uint8_t)(len >> 8);
        hdr[3] = (uint8_t)(len & 0xFF);
        hlen = 4;
    }

    send(fd, hdr, hlen, 0);
    send(fd, text, len, 0);
}

static int recv_exact(int fd, uint8_t *buf, size_t len, uint32_t timeout_ms = 3000)
{
    size_t got = 0;
    uint32_t t0 = millis();

    while (got < len && s_aria_running) {
        int r = recv(fd, buf + got, len - got, 0);
        if (r > 0) {
            got += r;
            t0 = millis();
        } else if (r == 0) {
            return -1; // peer closed
        } else {
            if (errno == EAGAIN || errno == EWOULDBLOCK) {
                if (millis() - t0 > timeout_ms) {
                    return -1;
                }
                vTaskDelay(pdMS_TO_TICKS(1));
            } else {
                return -1;
            }
        }
    }
    return (int)got;
}

/* ---------------------------------------------------------------- Client Management */

static void close_client(int idx)
{
    if (s_clients[idx].fd >= 0) {
        if (s_clients[idx].role == ROLE_AUDIO) {
            ariacast_stop_stream();
            Serial.println("[AriaCast] Audio streaming client disconnected");
        } else if (s_clients[idx].role == ROLE_CONTROL) {
            if (s_control_fd == s_clients[idx].fd) {
                s_control_fd = -1;
            }
            Serial.println("[AriaCast] Control client disconnected");
        }
        close(s_clients[idx].fd);
        s_clients[idx].fd = -1;
        s_clients[idx].role = ROLE_NONE;
        s_clients[idx].is_websocket = false;
    }
}

/* ---------------------------------------------------------------- Protocol Parsing */

static void handle_new_http_request(int idx)
{
    int fd = s_clients[idx].fd;
    char req_buf[1024];
    int n = recv(fd, req_buf, sizeof(req_buf) - 1, 0);
    if (n <= 0) {
        close_client(idx);
        return;
    }
    req_buf[n] = '\0';
    s_clients[idx].last_activity = millis();

    String req(req_buf);
    int first_line_end = req.indexOf("\r\n");
    if (first_line_end < 0) {
        close_client(idx);
        return;
    }

    String first_line = req.substring(0, first_line_end);

    // 1. Check for HTTP POST /metadata
    if (first_line.startsWith("POST /metadata")) {
        int body_pos = req.indexOf("\r\n\r\n");
        String body = "";
        if (body_pos >= 0) {
            body = req.substring(body_pos + 4);
        }

        JsonDocument doc;
        DeserializationError err = deserializeJson(doc, body);
        if (!err) {
            const char *title = doc["data"]["title"] | "";
            const char *artist = doc["data"]["artist"] | "";
            const char *album = doc["data"]["album"] | "";
            if (strlen(title) > 0 || strlen(artist) > 0) {
                ariacast_set_metadata(title, artist, album);
                Serial.printf("[AriaCast] Metadata via POST: '%s' by '%s'\n", title, artist);
            }
        }

        const char *resp = "HTTP/1.1 200 OK\r\n"
                           "Content-Type: application/json\r\n"
                           "Connection: close\r\n"
                           "Content-Length: 29\r\n\r\n"
                           "{\"type\":\"ack\",\"success\":true}";
        send(fd, resp, strlen(resp), 0);
        close_client(idx);
        return;
    }

    // 2. Check for WebSocket Upgrade
    if (req.indexOf("Upgrade: websocket") >= 0 || req.indexOf("Upgrade: WebSocket") >= 0) {
        // Extract Sec-WebSocket-Key
        int key_pos = req.indexOf("Sec-WebSocket-Key:");
        if (key_pos < 0) {
            key_pos = req.indexOf("sec-websocket-key:");
        }
        if (key_pos < 0) {
            close_client(idx);
            return;
        }

        int key_val_start = key_pos + 18;
        while (req_buf[key_val_start] == ' ') key_val_start++;
        int key_val_end = req.indexOf("\r\n", key_val_start);
        String ws_key = req.substring(key_val_start, key_val_end);
        ws_key.trim();

        char accept_str[36];
        compute_ws_accept(ws_key.c_str(), accept_str, sizeof(accept_str));

        char resp[256];
        snprintf(resp, sizeof(resp),
                 "HTTP/1.1 101 Switching Protocols\r\n"
                 "Upgrade: websocket\r\n"
                 "Connection: Upgrade\r\n"
                 "Sec-WebSocket-Accept: %s\r\n\r\n",
                 accept_str);
        send(fd, resp, strlen(resp), 0);

        s_clients[idx].is_websocket = true;

        if (first_line.indexOf("/audio") >= 0) {
            s_clients[idx].role = ROLE_AUDIO;
            Serial.println("[AriaCast] WebSocket /audio connected! Starting audio stream...");
            ariacast_start_stream();

            // Send initial handshake JSON
            const char *ready_msg = "{\"status\":\"READY\",\"sample_rate\":48000,\"channels\":2,\"frame_size\":3840}";
            ws_send_text(fd, ready_msg);

        } else if (first_line.indexOf("/control") >= 0) {
            s_clients[idx].role = ROLE_CONTROL;
            s_control_fd = fd;
            Serial.println("[AriaCast] WebSocket /control connected!");

            const char *ctrl_msg = "{\"status\":\"READY\",\"volume_available\":true,\"current_volume\":80}";
            ws_send_text(fd, ctrl_msg);

        } else if (first_line.indexOf("/metadata") >= 0) {
            s_clients[idx].role = ROLE_METADATA;
            Serial.println("[AriaCast] WebSocket /metadata connected!");

            const char *meta_msg = "{\"type\":\"metadata\",\"data\":{\"title\":\"Ready\",\"artist\":\"AriaCast\",\"album\":\"\",\"duration_ms\":0,\"position_ms\":0,\"is_playing\":false}}";
            ws_send_text(fd, meta_msg);

        } else if (first_line.indexOf("/stats") >= 0) {
            s_clients[idx].role = ROLE_STATS;
            const char *stats_msg = "{\"bufferedFrames\":0,\"receivedFrames\":0}";
            ws_send_text(fd, stats_msg);

        } else {
            s_clients[idx].role = ROLE_NONE;
        }

        return;
    }

    // Default: unrecognized request
    const char *bad = "HTTP/1.1 400 Bad Request\r\nConnection: close\r\n\r\n";
    send(fd, bad, strlen(bad), 0);
    close_client(idx);
}

static void handle_websocket_frame(int idx)
{
    int fd = s_clients[idx].fd;
    uint8_t hdr[2];
    if (recv_exact(fd, hdr, 2, 2000) != 2) {
        close_client(idx);
        return;
    }
    s_clients[idx].last_activity = millis();

    uint8_t opcode = hdr[0] & 0x0F;
    bool masked = (hdr[1] & 0x80) != 0;
    uint32_t payload_len = hdr[1] & 0x7F;

    if (payload_len == 126) {
        uint8_t ext[2];
        if (recv_exact(fd, ext, 2, 2000) != 2) {
            close_client(idx);
            return;
        }
        payload_len = ((uint32_t)ext[0] << 8) | ext[1];
    } else if (payload_len == 127) {
        uint8_t ext[8];
        if (recv_exact(fd, ext, 8, 2000) != 8) {
            close_client(idx);
            return;
        }
        payload_len = ((uint32_t)ext[4] << 24) | ((uint32_t)ext[5] << 16) | ((uint32_t)ext[6] << 8) | ext[7];
    }

    uint8_t mask[4] = {0};
    if (masked) {
        if (recv_exact(fd, mask, 4, 2000) != 4) {
            close_client(idx);
            return;
        }
    }

    // Ping frame: reply with Pong
    if (opcode == 0x09) {
        static uint8_t pong_buf[128];
        if (payload_len > 0 && payload_len < sizeof(pong_buf)) {
            recv_exact(fd, pong_buf, payload_len, 1000);
        }
        uint8_t pong_hdr[2] = {0x8A, 0x00};
        send(fd, pong_hdr, 2, 0);
        return;
    }

    // Close frame: close connection
    if (opcode == 0x08) {
        close_client(idx);
        return;
    }

    // 1. Binary Audio Frame (Opcode 0x02)
    if (opcode == 0x02 && s_clients[idx].role == ROLE_AUDIO) {
        static uint8_t audio_buf[4096];
        if (payload_len > sizeof(audio_buf)) {
            // oversized frame, skip
            return;
        }
        if (recv_exact(fd, audio_buf, payload_len, 3000) != (int)payload_len) {
            close_client(idx);
            return;
        }

        if (masked) {
            for (size_t i = 0; i < payload_len; i++) {
                audio_buf[i] ^= mask[i & 3];
            }
        }

        // Feed 16-bit 48kHz stereo PCM samples into ring buffer
        // (payload_len / 2 samples total)
        ariacast_feed_pcm((const int16_t *)audio_buf, payload_len / 2U, 2, 48000);
        return;
    }

    // 2. Text Frame (Opcode 0x01)
    if (opcode == 0x01) {
        static char text_buf[1024];
        if (payload_len >= sizeof(text_buf)) {
            return;
        }
        if (recv_exact(fd, (uint8_t *)text_buf, payload_len, 2000) != (int)payload_len) {
            close_client(idx);
            return;
        }
        text_buf[payload_len] = '\0';

        if (masked) {
            for (size_t i = 0; i < payload_len; i++) {
                text_buf[i] ^= mask[i & 3];
            }
        }

        // Process JSON
        JsonDocument doc;
        DeserializationError err = deserializeJson(doc, text_buf);
        if (!err) {
            if (s_clients[idx].role == ROLE_CONTROL) {
                const char *cmd = doc["command"] | "";
                if (strcmp(cmd, "volume_set") == 0) {
                    uint8_t lvl = doc["level"] | 80;
                    ariacast_set_volume(lvl);
                } else if (strcmp(cmd, "volume") == 0) {
                    const char *dir = doc["direction"] | "";
                    if (strcmp(dir, "up") == 0) {
                        // volume up
                    } else if (strcmp(dir, "down") == 0) {
                        // volume down
                    }
                }
                ws_send_text(fd, "{\"type\":\"ack\",\"success\":true}");
            } else if (s_clients[idx].role == ROLE_METADATA) {
                const char *type = doc["type"] | "";
                if (strcmp(type, "update") == 0) {
                    const char *title = doc["data"]["title"] | "";
                    const char *artist = doc["data"]["artist"] | "";
                    const char *album = doc["data"]["album"] | "";
                    ariacast_set_metadata(title, artist, album);
                    Serial.printf("[AriaCast] Metadata via WS: '%s' by '%s'\n", title, artist);
                    ws_send_text(fd, "{\"type\":\"ack\",\"success\":true}");
                }
            }
        }
        return;
    }

    // Other frame: discard payload
    static uint8_t discard[256];
    size_t rem = payload_len;
    while (rem > 0) {
        size_t chunk = rem > sizeof(discard) ? sizeof(discard) : rem;
        if (recv_exact(fd, discard, chunk, 1000) != (int)chunk) {
            close_client(idx);
            return;
        }
        rem -= chunk;
    }
}

/* ---------------------------------------------------------------- Server Task Loop */

static void ariacast_task_func(void *param)
{
    (void)param;

    // 1. Setup UDP Discovery socket on port 12888
    s_udp_fd = socket(AF_INET, SOCK_DGRAM, IPPROTO_UDP);
    if (s_udp_fd >= 0) {
        int opt = 1;
        setsockopt(s_udp_fd, SOL_SOCKET, SO_REUSEADDR, &opt, sizeof(opt));
        struct sockaddr_in udp_addr;
        memset(&udp_addr, 0, sizeof(udp_addr));
        udp_addr.sin_family = AF_INET;
        udp_addr.sin_port = htons(ARIACAST_DISCOVERY_PORT);
        udp_addr.sin_addr.s_addr = INADDR_ANY;
        if (bind(s_udp_fd, (struct sockaddr *)&udp_addr, sizeof(udp_addr)) < 0) {
            Serial.println("[AriaCast] Failed to bind UDP discovery port 12888");
            close(s_udp_fd);
            s_udp_fd = -1;
        } else {
            Serial.printf("[AriaCast] UDP discovery listener active on port %d\n", ARIACAST_DISCOVERY_PORT);
        }
    }

    // 2. Setup TCP Listening socket on port 12889
    s_listen_fd = socket(AF_INET, SOCK_STREAM, IPPROTO_TCP);
    if (s_listen_fd >= 0) {
        int opt = 1;
        setsockopt(s_listen_fd, SOL_SOCKET, SO_REUSEADDR, &opt, sizeof(opt));
        struct sockaddr_in tcp_addr;
        memset(&tcp_addr, 0, sizeof(tcp_addr));
        tcp_addr.sin_family = AF_INET;
        tcp_addr.sin_port = htons(ARIACAST_STREAMING_PORT);
        tcp_addr.sin_addr.s_addr = INADDR_ANY;
        if (bind(s_listen_fd, (struct sockaddr *)&tcp_addr, sizeof(tcp_addr)) < 0) {
            Serial.println("[AriaCast] Failed to bind TCP streaming port 12889");
            close(s_listen_fd);
            s_listen_fd = -1;
        } else {
            listen(s_listen_fd, 4);
            Serial.printf("[AriaCast] Native Streaming WebSocket server active on port %d\n", ARIACAST_STREAMING_PORT);
        }
    }

    for (int i = 0; i < MAX_WS_CLIENTS; i++) {
        s_clients[i].fd = -1;
        s_clients[i].role = ROLE_NONE;
        s_clients[i].is_websocket = false;
        s_clients[i].last_activity = 0;
    }

    s_aria_running = true;

    while (s_aria_running) {
        fd_set read_fds;
        FD_ZERO(&read_fds);
        int max_fd = -1;

        if (s_udp_fd >= 0) {
            FD_SET(s_udp_fd, &read_fds);
            if (s_udp_fd > max_fd) max_fd = s_udp_fd;
        }

        if (s_listen_fd >= 0) {
            FD_SET(s_listen_fd, &read_fds);
            if (s_listen_fd > max_fd) max_fd = s_listen_fd;
        }

        for (int i = 0; i < MAX_WS_CLIENTS; i++) {
            if (s_clients[i].fd >= 0) {
                FD_SET(s_clients[i].fd, &read_fds);
                if (s_clients[i].fd > max_fd) max_fd = s_clients[i].fd;
            }
        }

        struct timeval tv;
        tv.tv_sec = 0;
        tv.tv_usec = 50000; // 50 ms

        int sel = select(max_fd + 1, &read_fds, nullptr, nullptr, &tv);
        if (sel > 0) {
            // A. Check UDP discovery query
            if (s_udp_fd >= 0 && FD_ISSET(s_udp_fd, &read_fds)) {
                char udp_buf[128];
                struct sockaddr_in from;
                socklen_t from_len = sizeof(from);
                int len = recvfrom(s_udp_fd, udp_buf, sizeof(udp_buf) - 1, 0,
                                   (struct sockaddr *)&from, &from_len);
                if (len > 0) {
                    udp_buf[len] = '\0';
                    if (strstr(udp_buf, "DISCOVER_AUDIOCAST") != nullptr) {
                        IPAddress local_ip = (WiFi.getMode() == WIFI_STA && WiFi.status() == WL_CONNECTED)
                                             ? WiFi.localIP() : WiFi.softAPIP();
                        char resp[160];
                        snprintf(resp, sizeof(resp),
                                 "{\"server_name\":\"RT-Spark Hi-Fi\",\"ip\":\"%s\",\"port\":%d,\"samplerate\":48000,\"channels\":2}",
                                 local_ip.toString().c_str(), ARIACAST_STREAMING_PORT);
                        sendto(s_udp_fd, resp, strlen(resp), 0, (struct sockaddr *)&from, from_len);
                    }
                }
            }

            // B. Check new incoming TCP connection
            if (s_listen_fd >= 0 && FD_ISSET(s_listen_fd, &read_fds)) {
                struct sockaddr_in client_addr;
                socklen_t client_len = sizeof(client_addr);
                int client_fd = accept(s_listen_fd, (struct sockaddr *)&client_addr, &client_len);
                if (client_fd >= 0) {
                    int slot = -1;
                    for (int i = 0; i < MAX_WS_CLIENTS; i++) {
                        if (s_clients[i].fd < 0) {
                            slot = i;
                            break;
                        }
                    }
                    if (slot >= 0) {
                        s_clients[slot].fd = client_fd;
                        s_clients[slot].role = ROLE_NONE;
                        s_clients[slot].is_websocket = false;
                        s_clients[slot].last_activity = millis();
                    } else {
                        // No free slots
                        const char *busy = "HTTP/1.1 503 Service Unavailable\r\nConnection: close\r\n\r\n";
                        send(client_fd, busy, strlen(busy), 0);
                        close(client_fd);
                    }
                }
            }

            // C. Check existing clients
            for (int i = 0; i < MAX_WS_CLIENTS; i++) {
                if (s_clients[i].fd >= 0 && FD_ISSET(s_clients[i].fd, &read_fds)) {
                    if (!s_clients[i].is_websocket) {
                        handle_new_http_request(i);
                    } else {
                        handle_websocket_frame(i);
                    }
                }
            }
        }

        // Idle timeout check for dead connections (30 seconds)
        uint32_t now = millis();
        for (int i = 0; i < MAX_WS_CLIENTS; i++) {
            if (s_clients[i].fd >= 0 && (now - s_clients[i].last_activity > 30000)) {
                close_client(i);
            }
        }
    }

    if (s_udp_fd >= 0) { close(s_udp_fd); s_udp_fd = -1; }
    if (s_listen_fd >= 0) { close(s_listen_fd); s_listen_fd = -1; }
    for (int i = 0; i < MAX_WS_CLIENTS; i++) {
        close_client(i);
    }
    vTaskDelete(nullptr);
}

void ariacast_server_begin(void)
{
    if (s_aria_task != nullptr) {
        return;
    }
    xTaskCreatePinnedToCore(ariacast_task_func, "ariacast", 6144, nullptr, 5, &s_aria_task, 0);
}

void ariacast_server_stop(void)
{
    s_aria_running = false;
    s_aria_task = nullptr;
}

void ariacast_server_button_action(const char *action)
{
    if (s_control_fd >= 0 && action != nullptr) {
        char msg[64];
        snprintf(msg, sizeof(msg), "{\"action\":\"%s\"}", action);
        ws_send_text(s_control_fd, msg);
    }
}
```

## src/ariacast_server.h
```c
#ifndef ARIACAST_SERVER_H_
#define ARIACAST_SERVER_H_

#include <stdint.h>
#include <stdbool.h>

#ifdef __cplusplus
extern "C" {
#endif

#define ARIACAST_DISCOVERY_PORT 12888
#define ARIACAST_STREAMING_PORT 12889

/**
 * @brief Start AriaCast native UDP discovery and WebSocket audio server.
 */
void ariacast_server_begin(void);

/**
 * @brief Stop AriaCast server and close connections.
 */
void ariacast_server_stop(void);

/**
 * @brief Send playback action to AriaCast app (play, pause, next, previous).
 */
void ariacast_server_button_action(const char *action);

#ifdef __cplusplus
}
#endif

#endif /* ARIACAST_SERVER_H_ */
```
