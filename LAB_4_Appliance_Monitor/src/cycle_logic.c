/**
 * @file cycle_logic.c
 * @brief Baseline rules + trained random forest + hysteresis state machine.
 *
 * Bootstrap thresholds assume the board sits ON the appliance: idle floor is the
 * building's ambient noise (< 0.02 g RMS), agitation exceeds it with 1-3 Hz
 * dominance, and extract reaches a loud 8 Hz+ resonance. The Phase 5 report
 * documents how these rules compare against the trained forest on held-out data.
 */

#include "cycle_logic.h"
#include "vibration_features.h"
#include <stddef.h>

/* Trained model (generated by ml_model/train_cycle_model.py with emlearn) */
#include "cycle_model.h"

/* ---- Tuning constants (documented in docs/design.md) ---------------------- */
#define BASELINE_IDLE_RMS_G      0.020f  /* Below this the machine is quiet */
#define BASELINE_SPIN_RMS_G      0.080f  /* Extract vibration floor */
#define BASELINE_SPIN_DOM_HZ     8.0f    /* Extract resonance starts here */

#define HYST_CONFIRM_WINDOWS     2U      /* Consecutive windows to leave a state */
#define SPIN_MIN_DURATION_MS     8000U   /* Short bursts do not earn a DONE */
#define DONE_TIMEOUT_MS          300000U /* Unacknowledged DONE returns to IDLE after 5 min */

static cycle_state_t s_state;
static uint32_t s_state_entered_ms;
static uint32_t s_state_changes;
static int s_candidate;                 /* Hysteresis candidate class */
static uint32_t s_candidate_count;
static bool s_alert;
static uint32_t s_spin_start_ms;

void cycle_logic_reset(void)
{
    s_state = CYCLE_STATE_IDLE;
    s_state_entered_ms = 0;
    s_state_changes = 0;
    s_candidate = (int)CYCLE_IDLE;
    s_candidate_count = 0;
    s_alert = false;
    s_spin_start_ms = 0;
}

bool cycle_logic_acknowledge(void)
{
    if (!s_alert) {
        return false;
    }
    s_alert = false;
    s_state = CYCLE_STATE_IDLE;
    s_state_entered_ms = 0;
    return true;
}

cycle_state_t cycle_logic_state(void)
{
    return s_state;
}

bool cycle_logic_is_alerting(void)
{
    return s_alert;
}

uint32_t cycle_logic_state_age_ms(uint32_t now_ms)
{
    return now_ms - s_state_entered_ms;
}

int cycle_logic_baseline_classify(const float *features)
{
    if (features == NULL) {
        return (int)CYCLE_IDLE;
    }

    const float rms = features[FEAT_ACC_RMS];
    const float dom = features[FEAT_DOM_FREQ];

    if (rms < BASELINE_IDLE_RMS_G) {
        return (int)CYCLE_IDLE;
    }
    if (dom >= BASELINE_SPIN_DOM_HZ && rms >= BASELINE_SPIN_RMS_G) {
        return (int)CYCLE_SPIN;
    }
    return (int)CYCLE_WASH;
}

const char *cycle_state_name(cycle_state_t state)
{
    switch (state) {
    case CYCLE_STATE_WASH: return "WASH";
    case CYCLE_STATE_SPIN: return "SPIN";
    case CYCLE_STATE_DONE: return "DONE";
    default: return "IDLE";
    }
}

static void enter_state(cycle_state_t next, uint32_t now_ms)
{
    s_state = next;
    s_state_entered_ms = now_ms;
    if (next == CYCLE_STATE_SPIN) {
        s_spin_start_ms = now_ms;
    }
}

void cycle_logic_process(const float *features, uint32_t now_ms, cycle_decision_t *out)
{
    if (out == NULL) {
        return;
    }

    int baseline = cycle_logic_baseline_classify(features);
    int model = cycle_model_predict(features);

    /* ---- 2-window hysteresis on the trained model's class ----------------- */
    if ((int)s_state != model && s_state != CYCLE_STATE_DONE) {
        if (model == s_candidate) {
            s_candidate_count++;
        } else {
            s_candidate = model;
            s_candidate_count = 1;
        }
        if (s_candidate_count >= HYST_CONFIRM_WINDOWS) {
            /* A verified measured-state change */
            if (s_state == CYCLE_STATE_SPIN && model == (int)CYCLE_IDLE &&
                (now_ms - s_spin_start_ms) >= SPIN_MIN_DURATION_MS) {
                /* Extract phase ended: raise exactly one DONE alert */
                s_alert = true;
                s_state = CYCLE_STATE_DONE;
                s_state_entered_ms = now_ms;
            } else {
                enter_state((cycle_state_t)model, now_ms);
                s_state_changes++;
            }
            s_candidate_count = 0;
        }
    } else {
        s_candidate_count = 0;
    }

    /* Unacknowledged DONE falls back to IDLE after the timeout (alert clears) */
    if (s_state == CYCLE_STATE_DONE && (now_ms - s_state_entered_ms) >= DONE_TIMEOUT_MS) {
        s_alert = false;
        s_state = CYCLE_STATE_IDLE;
        s_state_entered_ms = now_ms;
    }

    out->state = s_state;
    out->model_class = model;
    out->baseline_class = baseline;
    out->models_agree = (model == baseline);
    out->alert_active = s_alert;
    out->state_age_ms = now_ms - s_state_entered_ms;
    out->state_changes = s_state_changes;
}
